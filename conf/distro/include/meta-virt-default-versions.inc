## conf/distro/include/meta-virt-default-versions.inc
```bitbake
# Meta-virtuailization PREFERED_VERSION

PREFERRED_VERSION_xen ?= "4.20%"
PREFERRED_VERSION_xen-tools ?= "4.20%"
```

## conf/distro/include/meta-virt-host.conf
```bitbake
# Base virtualization host configuration fragment
#
# Common DISTRO_FEATURES for any virtualization work: containers, Xen,
# k3s, or custom/mixed configurations.
#
# Use standalone for custom builds:
#
#   require conf/distro/include/meta-virt-host.conf
#   MACHINE = "qemux86-64"
#
# Or let a specific profile (container-host-*, xen-host-*) inherit it.

DISTRO_FEATURES:append = " virtualization systemd seccomp vmsep vcontainer"

# Container runtime provider — the unified runc recipe provides both
# runc-docker and runc-opencontainers via RPROVIDES
PREFERRED_PROVIDER_virtual/runc ?= "runc"

# Multiconfig for cross-arch vruntime builds (vdkr/vpdmn blobs)
BBMULTICONFIG ?= "vruntime-aarch64 vruntime-x86-64"
```
